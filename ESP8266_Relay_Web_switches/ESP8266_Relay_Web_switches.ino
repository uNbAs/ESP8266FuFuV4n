#include <ESP8266WiFi.h>
#include <ESP8266WebServerSecure.h>
#include <EEPROM.h>
#include <CertStoreBearSSL.h>

// Configuración para reducir memoria
#define USE_LWIP_HIGH_PERFORMANCE 1
#define LWIP_HTTPD_SUPPORT_11_KEEPALIVE 0

// Configuración WiFi
const char* ssid = "TUSSID";
const char* password = "TUPASSWORD";

// Configuración de pines
#define NUM_RELAYS 6
const uint8_t relayPins[NUM_RELAYS] = {D1, D2, D3, D4, D5, D6};

// Certificados (generar con los pasos posteriores)
static const uint8_t cert[] PROGMEM = {
  0x30, 0x82, 0x03, 0x05, 0x30, 0x82, 0x01, 0xed, 0xa0, 0x03, 0x02, 0x01,
  0x02, 0x02, 0x14, 0x1d, 0x61, 0x82, 0x36, 0x60, 0x31, 0x47, 0x8c, 0xa8,
  0xec, 0x1e, 0x08, 0xee, 0x27, 0x13, 0x06, 0x0e, 0x70, 0xd5, 0x68, 0x30,
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  0xa9, 0x2d, 0x85, 0xd1, 0xfb, 0x53, 0xd7, 0x1b, 0xc4
};

static const uint8_t key[] PROGMEM = {
  0x30, 0x82, 0x04, 0xbe, 0x02, 0x01, 0x00, 0x30, 0x0d, 0x06, 0x09, 0x2a,
  0x86, 0x48, 0x86, 0xf7, 0x0d, 0x01, 0x01, 0x01, 0x05, 0x00, 0x04, 0x82,
  0x04, 0xa8, 0x30, 0x82, 0x04, 0xa4, 0x02, 0x01, 0x00, 0x02, 0x82, 0x01,
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  0x88, 0x21, 0xf3, 0x9b, 0x87, 0x38
};

// Servidores
ESP8266WebServer serverHTTP(80);
BearSSL::ESP8266WebServerSecure serverHTTPS(443);
BearSSL::CertStore certStore;
bool relayStates[NUM_RELAYS] = {false};

void setup() {
  Serial.begin(115200);
  serverHTTP.begin();
  serverHTTPS.begin();

  // Inicializar EEPROM
  EEPROM.begin(512);
  for(int i=0; i<NUM_RELAYS; i++) {
    relayStates[i] = EEPROM.read(i);
    pinMode(relayPins[i], OUTPUT);
    digitalWrite(relayPins[i], relayStates[i]);
  }

  // Configurar SSL
  BearSSL::X509List *serverCertList = new BearSSL::X509List(cert, sizeof(cert));
  BearSSL::PrivateKey *serverPrivateKey = new BearSSL::PrivateKey(key, sizeof(key));
  serverHTTPS.setRSACert(serverCertList, serverPrivateKey);
  serverHTTPS.begin();

  // Conectar a WiFi
  WiFi.begin(ssid, password);
  while (WiFi.status() != WL_CONNECTED) delay(500);
  Serial.print("\nConectado! IP: ");
  Serial.println(WiFi.localIP());

  serverHTTP.onNotFound([](){
  String redirectUrl = "https://" + WiFi.localIP().toString() + serverHTTP.uri();
  serverHTTP.sendHeader("Location", redirectUrl);
  serverHTTP.send(301, "text/plain", "Redirigiendo a HTTPS...");
});

  // Configurar rutas
  serverHTTPS.on("/", []() {
    String html = R"=====(
    <!DOCTYPE html>
    <html>
    <head>
      <meta name="viewport" content="width=device-width, initial-scale=1.0, maximum-scale=1.0, user-scalable=no">
      <style>
        * { box-sizing: border-box; font-family: -apple-system, sans-serif; }
        body { margin: 0; padding: 20px; background: #f8f9fa; }
        .container {
          display: grid;
          grid-template-columns: repeat(2, 1fr);
          gap: 15px;
          max-width: 428px;
          margin: 0 auto;
        }
        .switch-btn {
          background: #ffffff;
          border-radius: 14px;
          padding: 18px;
          box-shadow: 0 2px 8px rgba(0,0,0,0.05);
          display: flex;
          align-items: center;
          justify-content: space-between;
        }
        .switch {
          position: relative;
          display: inline-block;
          width: 52px;
          height: 32px;
        }
        .switch input { opacity: 0; }
        .slider {
          position: absolute;
          cursor: pointer;
          top: 0;
          left: 0;
          right: 0;
          bottom: 0;
          background: #e9ecef;
          transition: .4s;
          border-radius: 16px;
        }
        .slider:before {
          position: absolute;
          content: "";
          height: 24px;
          width: 24px;
          left: 4px;
          bottom: 4px;
          background: white;
          transition: .4s;
          border-radius: 50%;
          box-shadow: 0 2px 4px rgba(0,0,0,0.1);
        }
        input:checked + .slider { background: #007aff; }
        input:checked + .slider:before { transform: translateX(20px); }
        .label { font-size: 17px; color: #1c1c1e; font-weight: 500; }
        h1 { text-align: center; color: #1c1c1e; font-size: 24px; margin: 0 0 30px; }
        @media (max-width: 480px) { .container { grid-template-columns: 1fr; } }
      </style>
    </head>
    <body>
      <h1>Control FuFuv4N</h1>
      <div class="container">
        <div class="switch-btn"><span class="label">Luz Interior</span><label class="switch"><input type="checkbox" id="relay1"><span class="slider"></span></label></div>
        <div class="switch-btn"><span class="label">Calefaccion</span><label class="switch"><input type="checkbox" id="relay2"><span class="slider"></span></label></div>
        <div class="switch-btn"><span class="label">Corriente 12V</span><label class="switch"><input type="checkbox" id="relay3"><span class="slider"></span></label></div>
        <div class="switch-btn"><span class="label">Inverter</span><label class="switch"><input type="checkbox" id="relay4"><span class="slider"></span></label></div>
        <div class="switch-btn"><span class="label">Agua</span><label class="switch"><input type="checkbox" id="relay5"><span class="slider"></span></label></div>
        <div class="switch-btn"><span class="label">Ducha</span><label class="switch"><input type="checkbox" id="relay6"><span class="slider"></span></label></div>
      </div>
      <script>
        const updateStatus = () => {
          fetch('/status')
            .then(r => r.json())
            .then(data => {
              for(let i=1; i<=6; i++) {
                document.getElementById('relay'+i).checked = data['relay'+i];
              }
            });
        };

        document.querySelectorAll('input[type="checkbox"]').forEach(el => {
          el.addEventListener('click', e => {
            fetch('/relay' + e.target.id.replace('relay',''))
              .then(r => r.text())
              .then(updateStatus);
          });
        });

        setInterval(updateStatus, 1000);
        updateStatus();
      </script>
    </body>
    </html>
    )=====";
    serverHTTPS.send(200, "text/html", html);
  });

  for(int i=1; i<=NUM_RELAYS; i++) {
    serverHTTPS.on(("/relay"+String(i)).c_str(), [i](){
      relayStates[i-1] = !relayStates[i-1];
      digitalWrite(relayPins[i-1], relayStates[i-1]);
      EEPROM.write(i-1, relayStates[i-1]);
      EEPROM.commit();
      serverHTTPS.send(200, "text/plain", "OK");
    });
  }

  serverHTTPS.on("/status", []() {
    String json = "{";
    for(int i=0; i<NUM_RELAYS; i++) {
      json += "\"relay" + String(i+1) + "\":" + String(relayStates[i] ? "true" : "false");
      if(i < NUM_RELAYS-1) json += ",";
    }
    json += "}";
    serverHTTPS.send(200, "application/json", json);
  });
}

void loop() {
  serverHTTP.handleClient();
  serverHTTPS.handleClient();
}
